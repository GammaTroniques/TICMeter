## firmware/sdkconfig.defaults
```kconfig
CONFIG_PM_POWER_DOWN_PERIPHERAL_IN_LIGHT_SLEEP=y
CONFIG_IEEE802154_SLEEP_ENABLE=y
CONFIG_FREERTOS_HZ=1000
CONFIG_ESP_SLEEP_POWER_DOWN_FLASH=y
CONFIG_IEEE802154_RECEIVE_DONE_HANDLER=y
CONFIG_ESP_PHY_MAC_BB_PD=y
CONFIG_ESP_ERR_TO_NAME_LOOKUP=y
```
